## sdkconfig.defaults.oct
```kconfig
# PSRAM bus mode for Octal-SPI PSRAM ESP32-S3 modules (4/8/16MB PSRAM: N8R8,
# N16R8, N16R8V, N32R8V, and other WROOM-2-family boards). Selected
# automatically by scripts/detect_board.py based on the connected chip.
CONFIG_SPIRAM_MODE_OCT=y
```

## sdkconfig.defaults.quad
```kconfig
# PSRAM bus mode for Quad-SPI PSRAM ESP32-S3 modules (2MB PSRAM: N8R2, N16R2,
# and other WROOM-1-family boards). Selected automatically by
# scripts/detect_board.py — also the safe fallback when detection fails.
CONFIG_SPIRAM_MODE_QUAD=y
```
